## conf/layer.conf
```bitbake
# Dise Player Yocto layer

BBPATH .= ":${LAYERDIR}"

BBFILES += "${LAYERDIR}/recipes-*/*/*.bb \
            ${LAYERDIR}/recipes-*/*/*.bbappend"

BBFILE_COLLECTIONS += "dise-player"
BBFILE_PATTERN_dise-player = "^${LAYERDIR}/"
BBFILE_PRIORITY_dise-player = "8"

LAYERDEPENDS_dise-player = "core"
LAYERSERIES_COMPAT_dise-player = "scarthgap"
```
